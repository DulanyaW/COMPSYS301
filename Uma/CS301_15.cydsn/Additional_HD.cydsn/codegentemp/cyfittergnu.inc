/*******************************************************************************
* File Name: cyfittergnu.inc
* 
* PSoC Creator  4.4
*
* Description:
* 
* This file is automatically generated by PSoC Creator.
*
********************************************************************************
* Copyright (c) 2007-2020 Cypress Semiconductor.  All rights reserved.
* You may use this file only in accordance with the license, terms, conditions, 
* disclaimers, and limitations in the end user license agreement accompanying 
* the software package with which this file was provided.
********************************************************************************/

.ifndef INCLUDED_CYFITTERGNU_INC
.set INCLUDED_CYFITTERGNU_INC, 1
.include "cydevicegnu.inc"
.include "cydevicegnu_trm.inc"

/* LED_0 */
.set LED_0__0__INTTYPE, CYREG_PICU2_INTTYPE0
.set LED_0__0__MASK, 0x01
.set LED_0__0__PC, CYREG_PRT2_PC0
.set LED_0__0__PORT, 2
.set LED_0__0__SHIFT, 0
.set LED_0__AG, CYREG_PRT2_AG
.set LED_0__AMUX, CYREG_PRT2_AMUX
.set LED_0__BIE, CYREG_PRT2_BIE
.set LED_0__BIT_MASK, CYREG_PRT2_BIT_MASK
.set LED_0__BYP, CYREG_PRT2_BYP
.set LED_0__CTL, CYREG_PRT2_CTL
.set LED_0__DM0, CYREG_PRT2_DM0
.set LED_0__DM1, CYREG_PRT2_DM1
.set LED_0__DM2, CYREG_PRT2_DM2
.set LED_0__DR, CYREG_PRT2_DR
.set LED_0__INP_DIS, CYREG_PRT2_INP_DIS
.set LED_0__INTTYPE_BASE, CYDEV_PICU_INTTYPE_PICU2_BASE
.set LED_0__LCD_COM_SEG, CYREG_PRT2_LCD_COM_SEG
.set LED_0__LCD_EN, CYREG_PRT2_LCD_EN
.set LED_0__MASK, 0x01
.set LED_0__PORT, 2
.set LED_0__PRT, CYREG_PRT2_PRT
.set LED_0__PRTDSI__CAPS_SEL, CYREG_PRT2_CAPS_SEL
.set LED_0__PRTDSI__DBL_SYNC_IN, CYREG_PRT2_DBL_SYNC_IN
.set LED_0__PRTDSI__OE_SEL0, CYREG_PRT2_OE_SEL0
.set LED_0__PRTDSI__OE_SEL1, CYREG_PRT2_OE_SEL1
.set LED_0__PRTDSI__OUT_SEL0, CYREG_PRT2_OUT_SEL0
.set LED_0__PRTDSI__OUT_SEL1, CYREG_PRT2_OUT_SEL1
.set LED_0__PRTDSI__SYNC_OUT, CYREG_PRT2_SYNC_OUT
.set LED_0__PS, CYREG_PRT2_PS
.set LED_0__SHIFT, 0
.set LED_0__SLW, CYREG_PRT2_SLW

/* LED_1 */
.set LED_1__0__INTTYPE, CYREG_PICU2_INTTYPE1
.set LED_1__0__MASK, 0x02
.set LED_1__0__PC, CYREG_PRT2_PC1
.set LED_1__0__PORT, 2
.set LED_1__0__SHIFT, 1
.set LED_1__AG, CYREG_PRT2_AG
.set LED_1__AMUX, CYREG_PRT2_AMUX
.set LED_1__BIE, CYREG_PRT2_BIE
.set LED_1__BIT_MASK, CYREG_PRT2_BIT_MASK
.set LED_1__BYP, CYREG_PRT2_BYP
.set LED_1__CTL, CYREG_PRT2_CTL
.set LED_1__DM0, CYREG_PRT2_DM0
.set LED_1__DM1, CYREG_PRT2_DM1
.set LED_1__DM2, CYREG_PRT2_DM2
.set LED_1__DR, CYREG_PRT2_DR
.set LED_1__INP_DIS, CYREG_PRT2_INP_DIS
.set LED_1__INTTYPE_BASE, CYDEV_PICU_INTTYPE_PICU2_BASE
.set LED_1__LCD_COM_SEG, CYREG_PRT2_LCD_COM_SEG
.set LED_1__LCD_EN, CYREG_PRT2_LCD_EN
.set LED_1__MASK, 0x02
.set LED_1__PORT, 2
.set LED_1__PRT, CYREG_PRT2_PRT
.set LED_1__PRTDSI__CAPS_SEL, CYREG_PRT2_CAPS_SEL
.set LED_1__PRTDSI__DBL_SYNC_IN, CYREG_PRT2_DBL_SYNC_IN
.set LED_1__PRTDSI__OE_SEL0, CYREG_PRT2_OE_SEL0
.set LED_1__PRTDSI__OE_SEL1, CYREG_PRT2_OE_SEL1
.set LED_1__PRTDSI__OUT_SEL0, CYREG_PRT2_OUT_SEL0
.set LED_1__PRTDSI__OUT_SEL1, CYREG_PRT2_OUT_SEL1
.set LED_1__PRTDSI__SYNC_OUT, CYREG_PRT2_SYNC_OUT
.set LED_1__PS, CYREG_PRT2_PS
.set LED_1__SHIFT, 1
.set LED_1__SLW, CYREG_PRT2_SLW

/* LED_2 */
.set LED_2__0__INTTYPE, CYREG_PICU2_INTTYPE2
.set LED_2__0__MASK, 0x04
.set LED_2__0__PC, CYREG_PRT2_PC2
.set LED_2__0__PORT, 2
.set LED_2__0__SHIFT, 2
.set LED_2__AG, CYREG_PRT2_AG
.set LED_2__AMUX, CYREG_PRT2_AMUX
.set LED_2__BIE, CYREG_PRT2_BIE
.set LED_2__BIT_MASK, CYREG_PRT2_BIT_MASK
.set LED_2__BYP, CYREG_PRT2_BYP
.set LED_2__CTL, CYREG_PRT2_CTL
.set LED_2__DM0, CYREG_PRT2_DM0
.set LED_2__DM1, CYREG_PRT2_DM1
.set LED_2__DM2, CYREG_PRT2_DM2
.set LED_2__DR, CYREG_PRT2_DR
.set LED_2__INP_DIS, CYREG_PRT2_INP_DIS
.set LED_2__INTTYPE_BASE, CYDEV_PICU_INTTYPE_PICU2_BASE
.set LED_2__LCD_COM_SEG, CYREG_PRT2_LCD_COM_SEG
.set LED_2__LCD_EN, CYREG_PRT2_LCD_EN
.set LED_2__MASK, 0x04
.set LED_2__PORT, 2
.set LED_2__PRT, CYREG_PRT2_PRT
.set LED_2__PRTDSI__CAPS_SEL, CYREG_PRT2_CAPS_SEL
.set LED_2__PRTDSI__DBL_SYNC_IN, CYREG_PRT2_DBL_SYNC_IN
.set LED_2__PRTDSI__OE_SEL0, CYREG_PRT2_OE_SEL0
.set LED_2__PRTDSI__OE_SEL1, CYREG_PRT2_OE_SEL1
.set LED_2__PRTDSI__OUT_SEL0, CYREG_PRT2_OUT_SEL0
.set LED_2__PRTDSI__OUT_SEL1, CYREG_PRT2_OUT_SEL1
.set LED_2__PRTDSI__SYNC_OUT, CYREG_PRT2_SYNC_OUT
.set LED_2__PS, CYREG_PRT2_PS
.set LED_2__SHIFT, 2
.set LED_2__SLW, CYREG_PRT2_SLW

/* Sin_L */
.set Sin_L__0__INTTYPE, CYREG_PICU3_INTTYPE2
.set Sin_L__0__MASK, 0x04
.set Sin_L__0__PC, CYREG_PRT3_PC2
.set Sin_L__0__PORT, 3
.set Sin_L__0__SHIFT, 2
.set Sin_L__AG, CYREG_PRT3_AG
.set Sin_L__AMUX, CYREG_PRT3_AMUX
.set Sin_L__BIE, CYREG_PRT3_BIE
.set Sin_L__BIT_MASK, CYREG_PRT3_BIT_MASK
.set Sin_L__BYP, CYREG_PRT3_BYP
.set Sin_L__CTL, CYREG_PRT3_CTL
.set Sin_L__DM0, CYREG_PRT3_DM0
.set Sin_L__DM1, CYREG_PRT3_DM1
.set Sin_L__DM2, CYREG_PRT3_DM2
.set Sin_L__DR, CYREG_PRT3_DR
.set Sin_L__INP_DIS, CYREG_PRT3_INP_DIS
.set Sin_L__INTTYPE_BASE, CYDEV_PICU_INTTYPE_PICU3_BASE
.set Sin_L__LCD_COM_SEG, CYREG_PRT3_LCD_COM_SEG
.set Sin_L__LCD_EN, CYREG_PRT3_LCD_EN
.set Sin_L__MASK, 0x04
.set Sin_L__PORT, 3
.set Sin_L__PRT, CYREG_PRT3_PRT
.set Sin_L__PRTDSI__CAPS_SEL, CYREG_PRT3_CAPS_SEL
.set Sin_L__PRTDSI__DBL_SYNC_IN, CYREG_PRT3_DBL_SYNC_IN
.set Sin_L__PRTDSI__OE_SEL0, CYREG_PRT3_OE_SEL0
.set Sin_L__PRTDSI__OE_SEL1, CYREG_PRT3_OE_SEL1
.set Sin_L__PRTDSI__OUT_SEL0, CYREG_PRT3_OUT_SEL0
.set Sin_L__PRTDSI__OUT_SEL1, CYREG_PRT3_OUT_SEL1
.set Sin_L__PRTDSI__SYNC_OUT, CYREG_PRT3_SYNC_OUT
.set Sin_L__PS, CYREG_PRT3_PS
.set Sin_L__SHIFT, 2
.set Sin_L__SLW, CYREG_PRT3_SLW

/* Sin_R */
.set Sin_R__0__INTTYPE, CYREG_PICU3_INTTYPE3
.set Sin_R__0__MASK, 0x08
.set Sin_R__0__PC, CYREG_PRT3_PC3
.set Sin_R__0__PORT, 3
.set Sin_R__0__SHIFT, 3
.set Sin_R__AG, CYREG_PRT3_AG
.set Sin_R__AMUX, CYREG_PRT3_AMUX
.set Sin_R__BIE, CYREG_PRT3_BIE
.set Sin_R__BIT_MASK, CYREG_PRT3_BIT_MASK
.set Sin_R__BYP, CYREG_PRT3_BYP
.set Sin_R__CTL, CYREG_PRT3_CTL
.set Sin_R__DM0, CYREG_PRT3_DM0
.set Sin_R__DM1, CYREG_PRT3_DM1
.set Sin_R__DM2, CYREG_PRT3_DM2
.set Sin_R__DR, CYREG_PRT3_DR
.set Sin_R__INP_DIS, CYREG_PRT3_INP_DIS
.set Sin_R__INTTYPE_BASE, CYDEV_PICU_INTTYPE_PICU3_BASE
.set Sin_R__LCD_COM_SEG, CYREG_PRT3_LCD_COM_SEG
.set Sin_R__LCD_EN, CYREG_PRT3_LCD_EN
.set Sin_R__MASK, 0x08
.set Sin_R__PORT, 3
.set Sin_R__PRT, CYREG_PRT3_PRT
.set Sin_R__PRTDSI__CAPS_SEL, CYREG_PRT3_CAPS_SEL
.set Sin_R__PRTDSI__DBL_SYNC_IN, CYREG_PRT3_DBL_SYNC_IN
.set Sin_R__PRTDSI__OE_SEL0, CYREG_PRT3_OE_SEL0
.set Sin_R__PRTDSI__OE_SEL1, CYREG_PRT3_OE_SEL1
.set Sin_R__PRTDSI__OUT_SEL0, CYREG_PRT3_OUT_SEL0
.set Sin_R__PRTDSI__OUT_SEL1, CYREG_PRT3_OUT_SEL1
.set Sin_R__PRTDSI__SYNC_OUT, CYREG_PRT3_SYNC_OUT
.set Sin_R__PS, CYREG_PRT3_PS
.set Sin_R__SHIFT, 3
.set Sin_R__SLW, CYREG_PRT3_SLW

/* isr_1 */
.set isr_1__INTC_CLR_EN_REG, CYREG_NVIC_CLRENA0
.set isr_1__INTC_CLR_PD_REG, CYREG_NVIC_CLRPEND0
.set isr_1__INTC_MASK, 0x20000
.set isr_1__INTC_NUMBER, 17
.set isr_1__INTC_PRIOR_NUM, 7
.set isr_1__INTC_PRIOR_REG, CYREG_NVIC_PRI_17
.set isr_1__INTC_SET_EN_REG, CYREG_NVIC_SETENA0
.set isr_1__INTC_SET_PD_REG, CYREG_NVIC_SETPEND0

/* isr_3 */
.set isr_3__INTC_CLR_EN_REG, CYREG_NVIC_CLRENA0
.set isr_3__INTC_CLR_PD_REG, CYREG_NVIC_CLRPEND0
.set isr_3__INTC_MASK, 0x40000
.set isr_3__INTC_NUMBER, 18
.set isr_3__INTC_PRIOR_NUM, 7
.set isr_3__INTC_PRIOR_REG, CYREG_NVIC_PRI_18
.set isr_3__INTC_SET_EN_REG, CYREG_NVIC_SETENA0
.set isr_3__INTC_SET_PD_REG, CYREG_NVIC_SETPEND0

/* Comp_0 */
.set Comp_0_ctComp__CLK, CYREG_CMP0_CLK
.set Comp_0_ctComp__CMP_MASK, 0x01
.set Comp_0_ctComp__CMP_NUMBER, 0
.set Comp_0_ctComp__CR, CYREG_CMP0_CR
.set Comp_0_ctComp__LUT__CR, CYREG_LUT0_CR
.set Comp_0_ctComp__LUT__MSK, CYREG_LUT_MSK
.set Comp_0_ctComp__LUT__MSK_MASK, 0x01
.set Comp_0_ctComp__LUT__MSK_SHIFT, 0
.set Comp_0_ctComp__LUT__MX, CYREG_LUT0_MX
.set Comp_0_ctComp__LUT__SR, CYREG_LUT_SR
.set Comp_0_ctComp__LUT__SR_MASK, 0x01
.set Comp_0_ctComp__LUT__SR_SHIFT, 0
.set Comp_0_ctComp__PM_ACT_CFG, CYREG_PM_ACT_CFG7
.set Comp_0_ctComp__PM_ACT_MSK, 0x01
.set Comp_0_ctComp__PM_STBY_CFG, CYREG_PM_STBY_CFG7
.set Comp_0_ctComp__PM_STBY_MSK, 0x01
.set Comp_0_ctComp__SW0, CYREG_CMP0_SW0
.set Comp_0_ctComp__SW2, CYREG_CMP0_SW2
.set Comp_0_ctComp__SW3, CYREG_CMP0_SW3
.set Comp_0_ctComp__SW4, CYREG_CMP0_SW4
.set Comp_0_ctComp__SW6, CYREG_CMP0_SW6
.set Comp_0_ctComp__TR0, CYREG_CMP0_TR0
.set Comp_0_ctComp__TR1, CYREG_CMP0_TR1
.set Comp_0_ctComp__TRIM__TR0, CYREG_FLSHID_MFG_CFG_CMP0_TR0
.set Comp_0_ctComp__TRIM__TR0_HS, CYREG_FLSHID_CUST_TABLES_CMP0_TR0_HS
.set Comp_0_ctComp__TRIM__TR1, CYREG_FLSHID_MFG_CFG_CMP0_TR1
.set Comp_0_ctComp__TRIM__TR1_HS, CYREG_FLSHID_CUST_TABLES_CMP0_TR1_HS
.set Comp_0_ctComp__WRK, CYREG_CMP_WRK
.set Comp_0_ctComp__WRK_MASK, 0x01
.set Comp_0_ctComp__WRK_SHIFT, 0

/* Comp_1 */
.set Comp_1_ctComp__CLK, CYREG_CMP3_CLK
.set Comp_1_ctComp__CMP_MASK, 0x08
.set Comp_1_ctComp__CMP_NUMBER, 3
.set Comp_1_ctComp__CR, CYREG_CMP3_CR
.set Comp_1_ctComp__LUT__CR, CYREG_LUT3_CR
.set Comp_1_ctComp__LUT__MSK, CYREG_LUT_MSK
.set Comp_1_ctComp__LUT__MSK_MASK, 0x08
.set Comp_1_ctComp__LUT__MSK_SHIFT, 3
.set Comp_1_ctComp__LUT__MX, CYREG_LUT3_MX
.set Comp_1_ctComp__LUT__SR, CYREG_LUT_SR
.set Comp_1_ctComp__LUT__SR_MASK, 0x08
.set Comp_1_ctComp__LUT__SR_SHIFT, 3
.set Comp_1_ctComp__PM_ACT_CFG, CYREG_PM_ACT_CFG7
.set Comp_1_ctComp__PM_ACT_MSK, 0x08
.set Comp_1_ctComp__PM_STBY_CFG, CYREG_PM_STBY_CFG7
.set Comp_1_ctComp__PM_STBY_MSK, 0x08
.set Comp_1_ctComp__SW0, CYREG_CMP3_SW0
.set Comp_1_ctComp__SW2, CYREG_CMP3_SW2
.set Comp_1_ctComp__SW3, CYREG_CMP3_SW3
.set Comp_1_ctComp__SW4, CYREG_CMP3_SW4
.set Comp_1_ctComp__SW6, CYREG_CMP3_SW6
.set Comp_1_ctComp__TR0, CYREG_CMP3_TR0
.set Comp_1_ctComp__TR1, CYREG_CMP3_TR1
.set Comp_1_ctComp__TRIM__TR0, CYREG_FLSHID_MFG_CFG_CMP3_TR0
.set Comp_1_ctComp__TRIM__TR0_HS, CYREG_FLSHID_CUST_TABLES_CMP3_TR0_HS
.set Comp_1_ctComp__TRIM__TR1, CYREG_FLSHID_MFG_CFG_CMP3_TR1
.set Comp_1_ctComp__TRIM__TR1_HS, CYREG_FLSHID_CUST_TABLES_CMP3_TR1_HS
.set Comp_1_ctComp__WRK, CYREG_CMP_WRK
.set Comp_1_ctComp__WRK_MASK, 0x08
.set Comp_1_ctComp__WRK_SHIFT, 3

/* Comp_2 */
.set Comp_2_ctComp__CLK, CYREG_CMP2_CLK
.set Comp_2_ctComp__CMP_MASK, 0x04
.set Comp_2_ctComp__CMP_NUMBER, 2
.set Comp_2_ctComp__CR, CYREG_CMP2_CR
.set Comp_2_ctComp__LUT__CR, CYREG_LUT2_CR
.set Comp_2_ctComp__LUT__MSK, CYREG_LUT_MSK
.set Comp_2_ctComp__LUT__MSK_MASK, 0x04
.set Comp_2_ctComp__LUT__MSK_SHIFT, 2
.set Comp_2_ctComp__LUT__MX, CYREG_LUT2_MX
.set Comp_2_ctComp__LUT__SR, CYREG_LUT_SR
.set Comp_2_ctComp__LUT__SR_MASK, 0x04
.set Comp_2_ctComp__LUT__SR_SHIFT, 2
.set Comp_2_ctComp__PM_ACT_CFG, CYREG_PM_ACT_CFG7
.set Comp_2_ctComp__PM_ACT_MSK, 0x04
.set Comp_2_ctComp__PM_STBY_CFG, CYREG_PM_STBY_CFG7
.set Comp_2_ctComp__PM_STBY_MSK, 0x04
.set Comp_2_ctComp__SW0, CYREG_CMP2_SW0
.set Comp_2_ctComp__SW2, CYREG_CMP2_SW2
.set Comp_2_ctComp__SW3, CYREG_CMP2_SW3
.set Comp_2_ctComp__SW4, CYREG_CMP2_SW4
.set Comp_2_ctComp__SW6, CYREG_CMP2_SW6
.set Comp_2_ctComp__TR0, CYREG_CMP2_TR0
.set Comp_2_ctComp__TR1, CYREG_CMP2_TR1
.set Comp_2_ctComp__TRIM__TR0, CYREG_FLSHID_MFG_CFG_CMP2_TR0
.set Comp_2_ctComp__TRIM__TR0_HS, CYREG_FLSHID_CUST_TABLES_CMP2_TR0_HS
.set Comp_2_ctComp__TRIM__TR1, CYREG_FLSHID_MFG_CFG_CMP2_TR1
.set Comp_2_ctComp__TRIM__TR1_HS, CYREG_FLSHID_CUST_TABLES_CMP2_TR1_HS
.set Comp_2_ctComp__WRK, CYREG_CMP_WRK
.set Comp_2_ctComp__WRK_MASK, 0x04
.set Comp_2_ctComp__WRK_SHIFT, 2

/* Comp_3 */
.set Comp_3_ctComp__CLK, CYREG_CMP1_CLK
.set Comp_3_ctComp__CMP_MASK, 0x02
.set Comp_3_ctComp__CMP_NUMBER, 1
.set Comp_3_ctComp__CR, CYREG_CMP1_CR
.set Comp_3_ctComp__LUT__CR, CYREG_LUT1_CR
.set Comp_3_ctComp__LUT__MSK, CYREG_LUT_MSK
.set Comp_3_ctComp__LUT__MSK_MASK, 0x02
.set Comp_3_ctComp__LUT__MSK_SHIFT, 1
.set Comp_3_ctComp__LUT__MX, CYREG_LUT1_MX
.set Comp_3_ctComp__LUT__SR, CYREG_LUT_SR
.set Comp_3_ctComp__LUT__SR_MASK, 0x02
.set Comp_3_ctComp__LUT__SR_SHIFT, 1
.set Comp_3_ctComp__PM_ACT_CFG, CYREG_PM_ACT_CFG7
.set Comp_3_ctComp__PM_ACT_MSK, 0x02
.set Comp_3_ctComp__PM_STBY_CFG, CYREG_PM_STBY_CFG7
.set Comp_3_ctComp__PM_STBY_MSK, 0x02
.set Comp_3_ctComp__SW0, CYREG_CMP1_SW0
.set Comp_3_ctComp__SW2, CYREG_CMP1_SW2
.set Comp_3_ctComp__SW3, CYREG_CMP1_SW3
.set Comp_3_ctComp__SW4, CYREG_CMP1_SW4
.set Comp_3_ctComp__SW6, CYREG_CMP1_SW6
.set Comp_3_ctComp__TR0, CYREG_CMP1_TR0
.set Comp_3_ctComp__TR1, CYREG_CMP1_TR1
.set Comp_3_ctComp__TRIM__TR0, CYREG_FLSHID_MFG_CFG_CMP1_TR0
.set Comp_3_ctComp__TRIM__TR0_HS, CYREG_FLSHID_CUST_TABLES_CMP1_TR0_HS
.set Comp_3_ctComp__TRIM__TR1, CYREG_FLSHID_MFG_CFG_CMP1_TR1
.set Comp_3_ctComp__TRIM__TR1_HS, CYREG_FLSHID_CUST_TABLES_CMP1_TR1_HS
.set Comp_3_ctComp__WRK, CYREG_CMP_WRK
.set Comp_3_ctComp__WRK_MASK, 0x02
.set Comp_3_ctComp__WRK_SHIFT, 1

/* Sin_M1 */
.set Sin_M1__0__INTTYPE, CYREG_PICU3_INTTYPE0
.set Sin_M1__0__MASK, 0x01
.set Sin_M1__0__PC, CYREG_PRT3_PC0
.set Sin_M1__0__PORT, 3
.set Sin_M1__0__SHIFT, 0
.set Sin_M1__AG, CYREG_PRT3_AG
.set Sin_M1__AMUX, CYREG_PRT3_AMUX
.set Sin_M1__BIE, CYREG_PRT3_BIE
.set Sin_M1__BIT_MASK, CYREG_PRT3_BIT_MASK
.set Sin_M1__BYP, CYREG_PRT3_BYP
.set Sin_M1__CTL, CYREG_PRT3_CTL
.set Sin_M1__DM0, CYREG_PRT3_DM0
.set Sin_M1__DM1, CYREG_PRT3_DM1
.set Sin_M1__DM2, CYREG_PRT3_DM2
.set Sin_M1__DR, CYREG_PRT3_DR
.set Sin_M1__INP_DIS, CYREG_PRT3_INP_DIS
.set Sin_M1__INTTYPE_BASE, CYDEV_PICU_INTTYPE_PICU3_BASE
.set Sin_M1__LCD_COM_SEG, CYREG_PRT3_LCD_COM_SEG
.set Sin_M1__LCD_EN, CYREG_PRT3_LCD_EN
.set Sin_M1__MASK, 0x01
.set Sin_M1__PORT, 3
.set Sin_M1__PRT, CYREG_PRT3_PRT
.set Sin_M1__PRTDSI__CAPS_SEL, CYREG_PRT3_CAPS_SEL
.set Sin_M1__PRTDSI__DBL_SYNC_IN, CYREG_PRT3_DBL_SYNC_IN
.set Sin_M1__PRTDSI__OE_SEL0, CYREG_PRT3_OE_SEL0
.set Sin_M1__PRTDSI__OE_SEL1, CYREG_PRT3_OE_SEL1
.set Sin_M1__PRTDSI__OUT_SEL0, CYREG_PRT3_OUT_SEL0
.set Sin_M1__PRTDSI__OUT_SEL1, CYREG_PRT3_OUT_SEL1
.set Sin_M1__PRTDSI__SYNC_OUT, CYREG_PRT3_SYNC_OUT
.set Sin_M1__PS, CYREG_PRT3_PS
.set Sin_M1__SHIFT, 0
.set Sin_M1__SLW, CYREG_PRT3_SLW

/* Sin_M2 */
.set Sin_M2__0__INTTYPE, CYREG_PICU3_INTTYPE1
.set Sin_M2__0__MASK, 0x02
.set Sin_M2__0__PC, CYREG_PRT3_PC1
.set Sin_M2__0__PORT, 3
.set Sin_M2__0__SHIFT, 1
.set Sin_M2__AG, CYREG_PRT3_AG
.set Sin_M2__AMUX, CYREG_PRT3_AMUX
.set Sin_M2__BIE, CYREG_PRT3_BIE
.set Sin_M2__BIT_MASK, CYREG_PRT3_BIT_MASK
.set Sin_M2__BYP, CYREG_PRT3_BYP
.set Sin_M2__CTL, CYREG_PRT3_CTL
.set Sin_M2__DM0, CYREG_PRT3_DM0
.set Sin_M2__DM1, CYREG_PRT3_DM1
.set Sin_M2__DM2, CYREG_PRT3_DM2
.set Sin_M2__DR, CYREG_PRT3_DR
.set Sin_M2__INP_DIS, CYREG_PRT3_INP_DIS
.set Sin_M2__INTTYPE_BASE, CYDEV_PICU_INTTYPE_PICU3_BASE
.set Sin_M2__LCD_COM_SEG, CYREG_PRT3_LCD_COM_SEG
.set Sin_M2__LCD_EN, CYREG_PRT3_LCD_EN
.set Sin_M2__MASK, 0x02
.set Sin_M2__PORT, 3
.set Sin_M2__PRT, CYREG_PRT3_PRT
.set Sin_M2__PRTDSI__CAPS_SEL, CYREG_PRT3_CAPS_SEL
.set Sin_M2__PRTDSI__DBL_SYNC_IN, CYREG_PRT3_DBL_SYNC_IN
.set Sin_M2__PRTDSI__OE_SEL0, CYREG_PRT3_OE_SEL0
.set Sin_M2__PRTDSI__OE_SEL1, CYREG_PRT3_OE_SEL1
.set Sin_M2__PRTDSI__OUT_SEL0, CYREG_PRT3_OUT_SEL0
.set Sin_M2__PRTDSI__OUT_SEL1, CYREG_PRT3_OUT_SEL1
.set Sin_M2__PRTDSI__SYNC_OUT, CYREG_PRT3_SYNC_OUT
.set Sin_M2__PS, CYREG_PRT3_PS
.set Sin_M2__SHIFT, 1
.set Sin_M2__SLW, CYREG_PRT3_SLW

/* Sout_L */
.set Sout_L__0__INTTYPE, CYREG_PICU12_INTTYPE4
.set Sout_L__0__MASK, 0x10
.set Sout_L__0__PC, CYREG_PRT12_PC4
.set Sout_L__0__PORT, 12
.set Sout_L__0__SHIFT, 4
.set Sout_L__AG, CYREG_PRT12_AG
.set Sout_L__BIE, CYREG_PRT12_BIE
.set Sout_L__BIT_MASK, CYREG_PRT12_BIT_MASK
.set Sout_L__BYP, CYREG_PRT12_BYP
.set Sout_L__DM0, CYREG_PRT12_DM0
.set Sout_L__DM1, CYREG_PRT12_DM1
.set Sout_L__DM2, CYREG_PRT12_DM2
.set Sout_L__DR, CYREG_PRT12_DR
.set Sout_L__INP_DIS, CYREG_PRT12_INP_DIS
.set Sout_L__INTTYPE_BASE, CYDEV_PICU_INTTYPE_PICU12_BASE
.set Sout_L__MASK, 0x10
.set Sout_L__PORT, 12
.set Sout_L__PRT, CYREG_PRT12_PRT
.set Sout_L__PRTDSI__DBL_SYNC_IN, CYREG_PRT12_DBL_SYNC_IN
.set Sout_L__PRTDSI__OE_SEL0, CYREG_PRT12_OE_SEL0
.set Sout_L__PRTDSI__OE_SEL1, CYREG_PRT12_OE_SEL1
.set Sout_L__PRTDSI__OUT_SEL0, CYREG_PRT12_OUT_SEL0
.set Sout_L__PRTDSI__OUT_SEL1, CYREG_PRT12_OUT_SEL1
.set Sout_L__PRTDSI__SYNC_OUT, CYREG_PRT12_SYNC_OUT
.set Sout_L__PS, CYREG_PRT12_PS
.set Sout_L__SHIFT, 4
.set Sout_L__SIO_CFG, CYREG_PRT12_SIO_CFG
.set Sout_L__SIO_DIFF, CYREG_PRT12_SIO_DIFF
.set Sout_L__SIO_HYST_EN, CYREG_PRT12_SIO_HYST_EN
.set Sout_L__SIO_REG_HIFREQ, CYREG_PRT12_SIO_REG_HIFREQ
.set Sout_L__SLW, CYREG_PRT12_SLW

/* Sout_R */
.set Sout_R__0__INTTYPE, CYREG_PICU12_INTTYPE3
.set Sout_R__0__MASK, 0x08
.set Sout_R__0__PC, CYREG_PRT12_PC3
.set Sout_R__0__PORT, 12
.set Sout_R__0__SHIFT, 3
.set Sout_R__AG, CYREG_PRT12_AG
.set Sout_R__BIE, CYREG_PRT12_BIE
.set Sout_R__BIT_MASK, CYREG_PRT12_BIT_MASK
.set Sout_R__BYP, CYREG_PRT12_BYP
.set Sout_R__DM0, CYREG_PRT12_DM0
.set Sout_R__DM1, CYREG_PRT12_DM1
.set Sout_R__DM2, CYREG_PRT12_DM2
.set Sout_R__DR, CYREG_PRT12_DR
.set Sout_R__INP_DIS, CYREG_PRT12_INP_DIS
.set Sout_R__INTTYPE_BASE, CYDEV_PICU_INTTYPE_PICU12_BASE
.set Sout_R__MASK, 0x08
.set Sout_R__PORT, 12
.set Sout_R__PRT, CYREG_PRT12_PRT
.set Sout_R__PRTDSI__DBL_SYNC_IN, CYREG_PRT12_DBL_SYNC_IN
.set Sout_R__PRTDSI__OE_SEL0, CYREG_PRT12_OE_SEL0
.set Sout_R__PRTDSI__OE_SEL1, CYREG_PRT12_OE_SEL1
.set Sout_R__PRTDSI__OUT_SEL0, CYREG_PRT12_OUT_SEL0
.set Sout_R__PRTDSI__OUT_SEL1, CYREG_PRT12_OUT_SEL1
.set Sout_R__PRTDSI__SYNC_OUT, CYREG_PRT12_SYNC_OUT
.set Sout_R__PS, CYREG_PRT12_PS
.set Sout_R__SHIFT, 3
.set Sout_R__SIO_CFG, CYREG_PRT12_SIO_CFG
.set Sout_R__SIO_DIFF, CYREG_PRT12_SIO_DIFF
.set Sout_R__SIO_HYST_EN, CYREG_PRT12_SIO_HYST_EN
.set Sout_R__SIO_REG_HIFREQ, CYREG_PRT12_SIO_REG_HIFREQ
.set Sout_R__SLW, CYREG_PRT12_SLW

/* Sout_M1 */
.set Sout_M1__0__INTTYPE, CYREG_PICU12_INTTYPE1
.set Sout_M1__0__MASK, 0x02
.set Sout_M1__0__PC, CYREG_PRT12_PC1
.set Sout_M1__0__PORT, 12
.set Sout_M1__0__SHIFT, 1
.set Sout_M1__AG, CYREG_PRT12_AG
.set Sout_M1__BIE, CYREG_PRT12_BIE
.set Sout_M1__BIT_MASK, CYREG_PRT12_BIT_MASK
.set Sout_M1__BYP, CYREG_PRT12_BYP
.set Sout_M1__DM0, CYREG_PRT12_DM0
.set Sout_M1__DM1, CYREG_PRT12_DM1
.set Sout_M1__DM2, CYREG_PRT12_DM2
.set Sout_M1__DR, CYREG_PRT12_DR
.set Sout_M1__INP_DIS, CYREG_PRT12_INP_DIS
.set Sout_M1__INTTYPE_BASE, CYDEV_PICU_INTTYPE_PICU12_BASE
.set Sout_M1__MASK, 0x02
.set Sout_M1__PORT, 12
.set Sout_M1__PRT, CYREG_PRT12_PRT
.set Sout_M1__PRTDSI__DBL_SYNC_IN, CYREG_PRT12_DBL_SYNC_IN
.set Sout_M1__PRTDSI__OE_SEL0, CYREG_PRT12_OE_SEL0
.set Sout_M1__PRTDSI__OE_SEL1, CYREG_PRT12_OE_SEL1
.set Sout_M1__PRTDSI__OUT_SEL0, CYREG_PRT12_OUT_SEL0
.set Sout_M1__PRTDSI__OUT_SEL1, CYREG_PRT12_OUT_SEL1
.set Sout_M1__PRTDSI__SYNC_OUT, CYREG_PRT12_SYNC_OUT
.set Sout_M1__PS, CYREG_PRT12_PS
.set Sout_M1__SHIFT, 1
.set Sout_M1__SIO_CFG, CYREG_PRT12_SIO_CFG
.set Sout_M1__SIO_DIFF, CYREG_PRT12_SIO_DIFF
.set Sout_M1__SIO_HYST_EN, CYREG_PRT12_SIO_HYST_EN
.set Sout_M1__SIO_REG_HIFREQ, CYREG_PRT12_SIO_REG_HIFREQ
.set Sout_M1__SLW, CYREG_PRT12_SLW

/* Sout_M2 */
.set Sout_M2__0__INTTYPE, CYREG_PICU12_INTTYPE2
.set Sout_M2__0__MASK, 0x04
.set Sout_M2__0__PC, CYREG_PRT12_PC2
.set Sout_M2__0__PORT, 12
.set Sout_M2__0__SHIFT, 2
.set Sout_M2__AG, CYREG_PRT12_AG
.set Sout_M2__BIE, CYREG_PRT12_BIE
.set Sout_M2__BIT_MASK, CYREG_PRT12_BIT_MASK
.set Sout_M2__BYP, CYREG_PRT12_BYP
.set Sout_M2__DM0, CYREG_PRT12_DM0
.set Sout_M2__DM1, CYREG_PRT12_DM1
.set Sout_M2__DM2, CYREG_PRT12_DM2
.set Sout_M2__DR, CYREG_PRT12_DR
.set Sout_M2__INP_DIS, CYREG_PRT12_INP_DIS
.set Sout_M2__INTTYPE_BASE, CYDEV_PICU_INTTYPE_PICU12_BASE
.set Sout_M2__MASK, 0x04
.set Sout_M2__PORT, 12
.set Sout_M2__PRT, CYREG_PRT12_PRT
.set Sout_M2__PRTDSI__DBL_SYNC_IN, CYREG_PRT12_DBL_SYNC_IN
.set Sout_M2__PRTDSI__OE_SEL0, CYREG_PRT12_OE_SEL0
.set Sout_M2__PRTDSI__OE_SEL1, CYREG_PRT12_OE_SEL1
.set Sout_M2__PRTDSI__OUT_SEL0, CYREG_PRT12_OUT_SEL0
.set Sout_M2__PRTDSI__OUT_SEL1, CYREG_PRT12_OUT_SEL1
.set Sout_M2__PRTDSI__SYNC_OUT, CYREG_PRT12_SYNC_OUT
.set Sout_M2__PS, CYREG_PRT12_PS
.set Sout_M2__SHIFT, 2
.set Sout_M2__SIO_CFG, CYREG_PRT12_SIO_CFG
.set Sout_M2__SIO_DIFF, CYREG_PRT12_SIO_DIFF
.set Sout_M2__SIO_HYST_EN, CYREG_PRT12_SIO_HYST_EN
.set Sout_M2__SIO_REG_HIFREQ, CYREG_PRT12_SIO_REG_HIFREQ
.set Sout_M2__SLW, CYREG_PRT12_SLW

/* Timer_1 */
.set Timer_1_TimerHW__CAP0, CYREG_TMR0_CAP0
.set Timer_1_TimerHW__CAP1, CYREG_TMR0_CAP1
.set Timer_1_TimerHW__CFG0, CYREG_TMR0_CFG0
.set Timer_1_TimerHW__CFG1, CYREG_TMR0_CFG1
.set Timer_1_TimerHW__CFG2, CYREG_TMR0_CFG2
.set Timer_1_TimerHW__CNT_CMP0, CYREG_TMR0_CNT_CMP0
.set Timer_1_TimerHW__CNT_CMP1, CYREG_TMR0_CNT_CMP1
.set Timer_1_TimerHW__PER0, CYREG_TMR0_PER0
.set Timer_1_TimerHW__PER1, CYREG_TMR0_PER1
.set Timer_1_TimerHW__PM_ACT_CFG, CYREG_PM_ACT_CFG3
.set Timer_1_TimerHW__PM_ACT_MSK, 0x01
.set Timer_1_TimerHW__PM_STBY_CFG, CYREG_PM_STBY_CFG3
.set Timer_1_TimerHW__PM_STBY_MSK, 0x01
.set Timer_1_TimerHW__RT0, CYREG_TMR0_RT0
.set Timer_1_TimerHW__RT1, CYREG_TMR0_RT1
.set Timer_1_TimerHW__SR0, CYREG_TMR0_SR0

/* Timer_2 */
.set Timer_2_TimerHW__CAP0, CYREG_TMR1_CAP0
.set Timer_2_TimerHW__CAP1, CYREG_TMR1_CAP1
.set Timer_2_TimerHW__CFG0, CYREG_TMR1_CFG0
.set Timer_2_TimerHW__CFG1, CYREG_TMR1_CFG1
.set Timer_2_TimerHW__CFG2, CYREG_TMR1_CFG2
.set Timer_2_TimerHW__CNT_CMP0, CYREG_TMR1_CNT_CMP0
.set Timer_2_TimerHW__CNT_CMP1, CYREG_TMR1_CNT_CMP1
.set Timer_2_TimerHW__PER0, CYREG_TMR1_PER0
.set Timer_2_TimerHW__PER1, CYREG_TMR1_PER1
.set Timer_2_TimerHW__PM_ACT_CFG, CYREG_PM_ACT_CFG3
.set Timer_2_TimerHW__PM_ACT_MSK, 0x02
.set Timer_2_TimerHW__PM_STBY_CFG, CYREG_PM_STBY_CFG3
.set Timer_2_TimerHW__PM_STBY_MSK, 0x02
.set Timer_2_TimerHW__RT0, CYREG_TMR1_RT0
.set Timer_2_TimerHW__RT1, CYREG_TMR1_RT1
.set Timer_2_TimerHW__SR0, CYREG_TMR1_SR0

/* comp_clk */
.set comp_clk__CFG0, CYREG_CLKDIST_ACFG0_CFG0
.set comp_clk__CFG1, CYREG_CLKDIST_ACFG0_CFG1
.set comp_clk__CFG2, CYREG_CLKDIST_ACFG0_CFG2
.set comp_clk__CFG2_SRC_SEL_MASK, 0x07
.set comp_clk__CFG3, CYREG_CLKDIST_ACFG0_CFG3
.set comp_clk__CFG3_PHASE_DLY_MASK, 0x0F
.set comp_clk__INDEX, 0x00
.set comp_clk__PM_ACT_CFG, CYREG_PM_ACT_CFG1
.set comp_clk__PM_ACT_MSK, 0x01
.set comp_clk__PM_STBY_CFG, CYREG_PM_STBY_CFG1
.set comp_clk__PM_STBY_MSK, 0x01

/* timer_clock_1 */
.set timer_clock_1__CFG0, CYREG_CLKDIST_DCFG1_CFG0
.set timer_clock_1__CFG1, CYREG_CLKDIST_DCFG1_CFG1
.set timer_clock_1__CFG2, CYREG_CLKDIST_DCFG1_CFG2
.set timer_clock_1__CFG2_SRC_SEL_MASK, 0x07
.set timer_clock_1__INDEX, 0x01
.set timer_clock_1__PM_ACT_CFG, CYREG_PM_ACT_CFG2
.set timer_clock_1__PM_ACT_MSK, 0x02
.set timer_clock_1__PM_STBY_CFG, CYREG_PM_STBY_CFG2
.set timer_clock_1__PM_STBY_MSK, 0x02

/* timer_clock_2 */
.set timer_clock_2__CFG0, CYREG_CLKDIST_DCFG0_CFG0
.set timer_clock_2__CFG1, CYREG_CLKDIST_DCFG0_CFG1
.set timer_clock_2__CFG2, CYREG_CLKDIST_DCFG0_CFG2
.set timer_clock_2__CFG2_SRC_SEL_MASK, 0x07
.set timer_clock_2__INDEX, 0x00
.set timer_clock_2__PM_ACT_CFG, CYREG_PM_ACT_CFG2
.set timer_clock_2__PM_ACT_MSK, 0x01
.set timer_clock_2__PM_STBY_CFG, CYREG_PM_STBY_CFG2
.set timer_clock_2__PM_STBY_MSK, 0x01

/* Miscellaneous */
.set BCLK__BUS_CLK__HZ, 48000000
.set BCLK__BUS_CLK__KHZ, 48000
.set BCLK__BUS_CLK__MHZ, 48
.set CYDEV_CHIP_DIE_LEOPARD, 1
.set CYDEV_CHIP_DIE_PSOC4A, 26
.set CYDEV_CHIP_DIE_PSOC5LP, 2
.set CYDEV_CHIP_DIE_PSOC5TM, 3
.set CYDEV_CHIP_DIE_TMA4, 4
.set CYDEV_CHIP_DIE_UNKNOWN, 0
.set CYDEV_CHIP_FAMILY_FM0P, 5
.set CYDEV_CHIP_FAMILY_FM3, 6
.set CYDEV_CHIP_FAMILY_FM4, 7
.set CYDEV_CHIP_FAMILY_PSOC3, 1
.set CYDEV_CHIP_FAMILY_PSOC4, 2
.set CYDEV_CHIP_FAMILY_PSOC5, 3
.set CYDEV_CHIP_FAMILY_PSOC6, 4
.set CYDEV_CHIP_FAMILY_UNKNOWN, 0
.set CYDEV_CHIP_FAMILY_USED, CYDEV_CHIP_FAMILY_PSOC5
.set CYDEV_CHIP_JTAG_ID, 0x2E161069
.set CYDEV_CHIP_MEMBER_3A, 1
.set CYDEV_CHIP_MEMBER_4A, 26
.set CYDEV_CHIP_MEMBER_4AA, 25
.set CYDEV_CHIP_MEMBER_4AB, 30
.set CYDEV_CHIP_MEMBER_4AC, 14
.set CYDEV_CHIP_MEMBER_4AD, 15
.set CYDEV_CHIP_MEMBER_4AE, 16
.set CYDEV_CHIP_MEMBER_4D, 20
.set CYDEV_CHIP_MEMBER_4E, 6
.set CYDEV_CHIP_MEMBER_4F, 27
.set CYDEV_CHIP_MEMBER_4G, 4
.set CYDEV_CHIP_MEMBER_4H, 24
.set CYDEV_CHIP_MEMBER_4I, 32
.set CYDEV_CHIP_MEMBER_4J, 21
.set CYDEV_CHIP_MEMBER_4K, 22
.set CYDEV_CHIP_MEMBER_4L, 31
.set CYDEV_CHIP_MEMBER_4M, 29
.set CYDEV_CHIP_MEMBER_4N, 11
.set CYDEV_CHIP_MEMBER_4O, 8
.set CYDEV_CHIP_MEMBER_4P, 28
.set CYDEV_CHIP_MEMBER_4Q, 17
.set CYDEV_CHIP_MEMBER_4R, 9
.set CYDEV_CHIP_MEMBER_4S, 12
.set CYDEV_CHIP_MEMBER_4T, 10
.set CYDEV_CHIP_MEMBER_4U, 5
.set CYDEV_CHIP_MEMBER_4V, 23
.set CYDEV_CHIP_MEMBER_4W, 13
.set CYDEV_CHIP_MEMBER_4X, 7
.set CYDEV_CHIP_MEMBER_4Y, 18
.set CYDEV_CHIP_MEMBER_4Z, 19
.set CYDEV_CHIP_MEMBER_5A, 3
.set CYDEV_CHIP_MEMBER_5B, 2
.set CYDEV_CHIP_MEMBER_6A, 33
.set CYDEV_CHIP_MEMBER_FM3, 37
.set CYDEV_CHIP_MEMBER_FM4, 38
.set CYDEV_CHIP_MEMBER_PDL_FM0P_TYPE1, 34
.set CYDEV_CHIP_MEMBER_PDL_FM0P_TYPE2, 35
.set CYDEV_CHIP_MEMBER_PDL_FM0P_TYPE3, 36
.set CYDEV_CHIP_MEMBER_UNKNOWN, 0
.set CYDEV_CHIP_MEMBER_USED, CYDEV_CHIP_MEMBER_5B
.set CYDEV_CHIP_DIE_EXPECT, CYDEV_CHIP_MEMBER_USED
.set CYDEV_CHIP_DIE_ACTUAL, CYDEV_CHIP_DIE_EXPECT
.set CYDEV_CHIP_REV_LEOPARD_ES1, 0
.set CYDEV_CHIP_REV_LEOPARD_ES2, 1
.set CYDEV_CHIP_REV_LEOPARD_ES3, 3
.set CYDEV_CHIP_REV_LEOPARD_PRODUCTION, 3
.set CYDEV_CHIP_REV_PSOC4A_ES0, 17
.set CYDEV_CHIP_REV_PSOC4A_PRODUCTION, 17
.set CYDEV_CHIP_REV_PSOC5LP_ES0, 0
.set CYDEV_CHIP_REV_PSOC5LP_PRODUCTION, 0
.set CYDEV_CHIP_REV_PSOC5TM_ES0, 0
.set CYDEV_CHIP_REV_PSOC5TM_ES1, 1
.set CYDEV_CHIP_REV_PSOC5TM_PRODUCTION, 1
.set CYDEV_CHIP_REV_TMA4_ES, 17
.set CYDEV_CHIP_REV_TMA4_ES2, 33
.set CYDEV_CHIP_REV_TMA4_PRODUCTION, 17
.set CYDEV_CHIP_REVISION_3A_ES1, 0
.set CYDEV_CHIP_REVISION_3A_ES2, 1
.set CYDEV_CHIP_REVISION_3A_ES3, 3
.set CYDEV_CHIP_REVISION_3A_PRODUCTION, 3
.set CYDEV_CHIP_REVISION_4A_ES0, 17
.set CYDEV_CHIP_REVISION_4A_PRODUCTION, 17
.set CYDEV_CHIP_REVISION_4AA_PRODUCTION, 0
.set CYDEV_CHIP_REVISION_4AB_PRODUCTION, 0
.set CYDEV_CHIP_REVISION_4AC_PRODUCTION, 0
.set CYDEV_CHIP_REVISION_4AD_PRODUCTION, 0
.set CYDEV_CHIP_REVISION_4AE_PRODUCTION, 0
.set CYDEV_CHIP_REVISION_4D_PRODUCTION, 0
.set CYDEV_CHIP_REVISION_4E_CCG2_NO_USBPD, 0
.set CYDEV_CHIP_REVISION_4E_PRODUCTION, 0
.set CYDEV_CHIP_REVISION_4F_PRODUCTION, 0
.set CYDEV_CHIP_REVISION_4F_PRODUCTION_256DMA, 0
.set CYDEV_CHIP_REVISION_4F_PRODUCTION_256K, 0
.set CYDEV_CHIP_REVISION_4G_ES, 17
.set CYDEV_CHIP_REVISION_4G_ES2, 33
.set CYDEV_CHIP_REVISION_4G_PRODUCTION, 17
.set CYDEV_CHIP_REVISION_4H_PRODUCTION, 0
.set CYDEV_CHIP_REVISION_4I_PRODUCTION, 0
.set CYDEV_CHIP_REVISION_4J_PRODUCTION, 0
.set CYDEV_CHIP_REVISION_4K_PRODUCTION, 0
.set CYDEV_CHIP_REVISION_4L_PRODUCTION, 0
.set CYDEV_CHIP_REVISION_4M_PRODUCTION, 0
.set CYDEV_CHIP_REVISION_4N_PRODUCTION, 0
.set CYDEV_CHIP_REVISION_4O_PRODUCTION, 0
.set CYDEV_CHIP_REVISION_4P_PRODUCTION, 0
.set CYDEV_CHIP_REVISION_4Q_PRODUCTION, 0
.set CYDEV_CHIP_REVISION_4R_PRODUCTION, 0
.set CYDEV_CHIP_REVISION_4S_PRODUCTION, 0
.set CYDEV_CHIP_REVISION_4T_PRODUCTION, 0
.set CYDEV_CHIP_REVISION_4U_PRODUCTION, 0
.set CYDEV_CHIP_REVISION_4V_PRODUCTION, 0
.set CYDEV_CHIP_REVISION_4W_PRODUCTION, 0
.set CYDEV_CHIP_REVISION_4X_PRODUCTION, 0
.set CYDEV_CHIP_REVISION_4Y_PRODUCTION, 0
.set CYDEV_CHIP_REVISION_4Z_PRODUCTION, 0
.set CYDEV_CHIP_REVISION_5A_ES0, 0
.set CYDEV_CHIP_REVISION_5A_ES1, 1
.set CYDEV_CHIP_REVISION_5A_PRODUCTION, 1
.set CYDEV_CHIP_REVISION_5B_ES0, 0
.set CYDEV_CHIP_REVISION_5B_PRODUCTION, 0
.set CYDEV_CHIP_REVISION_6A_ES, 17
.set CYDEV_CHIP_REVISION_6A_NO_UDB, 33
.set CYDEV_CHIP_REVISION_6A_PRODUCTION, 33
.set CYDEV_CHIP_REVISION_FM3_PRODUCTION, 0
.set CYDEV_CHIP_REVISION_FM4_PRODUCTION, 0
.set CYDEV_CHIP_REVISION_PDL_FM0P_TYPE1_PRODUCTION, 0
.set CYDEV_CHIP_REVISION_PDL_FM0P_TYPE2_PRODUCTION, 0
.set CYDEV_CHIP_REVISION_PDL_FM0P_TYPE3_PRODUCTION, 0
.set CYDEV_CHIP_REVISION_USED, CYDEV_CHIP_REVISION_5B_PRODUCTION
.set CYDEV_CHIP_REV_EXPECT, CYDEV_CHIP_REVISION_USED
.set CYDEV_CONFIG_FASTBOOT_ENABLED, 1
.set CYDEV_CONFIG_UNUSED_IO_AllowButWarn, 0
.set CYDEV_CONFIG_UNUSED_IO, CYDEV_CONFIG_UNUSED_IO_AllowButWarn
.set CYDEV_CONFIG_UNUSED_IO_AllowWithInfo, 1
.set CYDEV_CONFIG_UNUSED_IO_Disallowed, 2
.set CYDEV_CONFIGURATION_COMPRESSED, 1
.set CYDEV_CONFIGURATION_DMA, 0
.set CYDEV_CONFIGURATION_ECC, 1
.set CYDEV_CONFIGURATION_IMOENABLED, CYDEV_CONFIG_FASTBOOT_ENABLED
.set CYDEV_CONFIGURATION_MODE_COMPRESSED, 0
.set CYDEV_CONFIGURATION_MODE, CYDEV_CONFIGURATION_MODE_COMPRESSED
.set CYDEV_CONFIGURATION_MODE_DMA, 2
.set CYDEV_CONFIGURATION_MODE_UNCOMPRESSED, 1
.set CYDEV_DEBUG_ENABLE_MASK, 0x20
.set CYDEV_DEBUG_ENABLE_REGISTER, CYREG_MLOGIC_DEBUG
.set CYDEV_DEBUGGING_DPS_Disable, 3
.set CYDEV_DEBUGGING_DPS_JTAG_4, 1
.set CYDEV_DEBUGGING_DPS_JTAG_5, 0
.set CYDEV_DEBUGGING_DPS_SWD, 2
.set CYDEV_DEBUGGING_DPS_SWD_SWV, 6
.set CYDEV_DEBUGGING_DPS, CYDEV_DEBUGGING_DPS_SWD_SWV
.set CYDEV_DEBUGGING_ENABLE, 1
.set CYDEV_DEBUGGING_XRES, 0
.set CYDEV_DMA_CHANNELS_AVAILABLE, 24
.set CYDEV_ECC_ENABLE, 0
.set CYDEV_HEAP_SIZE, 0x80
.set CYDEV_INSTRUCT_CACHE_ENABLED, 1
.set CYDEV_INTR_RISING, 0x00000000
.set CYDEV_IS_EXPORTING_CODE, 0
.set CYDEV_IS_IMPORTING_CODE, 0
.set CYDEV_PROJ_TYPE, 0
.set CYDEV_PROJ_TYPE_BOOTLOADER, 1
.set CYDEV_PROJ_TYPE_LAUNCHER, 5
.set CYDEV_PROJ_TYPE_LOADABLE, 2
.set CYDEV_PROJ_TYPE_LOADABLEANDBOOTLOADER, 4
.set CYDEV_PROJ_TYPE_MULTIAPPBOOTLOADER, 3
.set CYDEV_PROJ_TYPE_STANDARD, 0
.set CYDEV_PROTECTION_ENABLE, 0
.set CYDEV_STACK_SIZE, 0x0800
.set CYDEV_USB_CLK_OSC_LOCKING_ENABLED_AT_PWR_UP, 1
.set CYDEV_USE_BUNDLED_CMSIS, 1
.set CYDEV_VARIABLE_VDDA, 0
.set CYDEV_VDDA_MV, 5000
.set CYDEV_VDDD_MV, 5000
.set CYDEV_VDDIO0_MV, 5000
.set CYDEV_VDDIO1_MV, 5000
.set CYDEV_VDDIO2_MV, 5000
.set CYDEV_VDDIO3_MV, 5000
.set CYDEV_VIO0_MV, 5000
.set CYDEV_VIO1_MV, 5000
.set CYDEV_VIO2_MV, 5000
.set CYDEV_VIO3_MV, 5000
.set CYIPBLOCK_ARM_CM3_VERSION, 0
.set CYIPBLOCK_P3_ANAIF_VERSION, 0
.set CYIPBLOCK_P3_CAN_VERSION, 0
.set CYIPBLOCK_P3_CAPSENSE_VERSION, 0
.set CYIPBLOCK_P3_COMP_VERSION, 0
.set CYIPBLOCK_P3_DECIMATOR_VERSION, 0
.set CYIPBLOCK_P3_DFB_VERSION, 0
.set CYIPBLOCK_P3_DMA_VERSION, 0
.set CYIPBLOCK_P3_DRQ_VERSION, 0
.set CYIPBLOCK_P3_DSM_VERSION, 0
.set CYIPBLOCK_P3_EMIF_VERSION, 0
.set CYIPBLOCK_P3_I2C_VERSION, 0
.set CYIPBLOCK_P3_LCD_VERSION, 0
.set CYIPBLOCK_P3_LPF_VERSION, 0
.set CYIPBLOCK_P3_OPAMP_VERSION, 0
.set CYIPBLOCK_P3_PM_VERSION, 0
.set CYIPBLOCK_P3_SCCT_VERSION, 0
.set CYIPBLOCK_P3_TIMER_VERSION, 0
.set CYIPBLOCK_P3_USB_VERSION, 0
.set CYIPBLOCK_P3_VIDAC_VERSION, 0
.set CYIPBLOCK_P3_VREF_VERSION, 0
.set CYIPBLOCK_S8_GPIO_VERSION, 0
.set CYIPBLOCK_S8_IRQ_VERSION, 0
.set CYIPBLOCK_S8_SAR_VERSION, 0
.set CYIPBLOCK_S8_SIO_VERSION, 0
.set CYIPBLOCK_S8_UDB_VERSION, 0
.set DMA_CHANNELS_USED__MASK0, 0x00000000
.set CYDEV_BOOTLOADER_ENABLE, 0
.endif
